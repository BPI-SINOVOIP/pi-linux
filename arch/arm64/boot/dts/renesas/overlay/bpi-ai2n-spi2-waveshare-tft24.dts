/dts-v1/;
/plugin/;

#include <dt-bindings/pinctrl/rzg2l-pinctrl.h>
#include <dt-bindings/gpio/gpio.h>

/ {
	compatible = "renesas,r9a09g056";

	fragment@0 {
		target-path = "/aliases";
		__overlay__ {
			spi2 = "/soc/spi@12800800";
		};
	};

	fragment@1 {
		target-path = "/soc/spi@12800800";
		__overlay__ {
			status = "okay";

			tft24: tft24@0 {
				compatible = "ilitek,ili9341";
				reg = <0>;
				spi-max-frequency = <50000000>;
				rotate = <90>;
				bgr = <0>;
				fps = <30>;
				buswidth = <8>;
				reset-gpios = <&pinctrl RZG2L_GPIO(5, 3) GPIO_ACTIVE_LOW>;  //phy.22
				dc-gpios = <&pinctrl RZG2L_GPIO(5, 6) GPIO_ACTIVE_HIGH>;    //phy.18
				led-gpios = <&pinctrl RZG2L_GPIO(10, 7) GPIO_ACTIVE_HIGH>;   //phy.24
				debug = <0>;
			};
		};	
	};
};
