/dts-v1/;
/plugin/;

/ {
	compatible = "renesas,r9a09g056";

	fragment@0 {
		target-path = "/aliases";
		__overlay__ {
			serial2 = "/soc/serial@12801400";
		};
	};

	fragment@1 {
		target-path = "/soc/serial@12801400";
		__overlay__ {
			status = "okay";
		};	
	};
};
