/dts-v1/;
/plugin/;

/ {
	compatible = "renesas,r9a09g056";

	fragment@0 {
		target-path = "/aliases";
		__overlay__ {
			serial1 = "/soc/serial@12800c00";
		};
	};

	fragment@1 {
		target-path = "/soc/serial@12800c00";
		__overlay__ {
			status = "okay";
		};	
	};
};
