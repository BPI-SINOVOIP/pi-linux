/dts-v1/;
/plugin/;

/ {
	compatible = "renesas,r9a09g056";

	fragment@0 {
		target-path = "/aliases";
		__overlay__ {
			i2c1 = "/soc/i2c@14400800";
		};
	};

	fragment@1 {
		target-path = "/soc/i2c@14400800";
		__overlay__ {
			status = "okay";

			at24@50 {
				compatible = "atmel,24c02";
				reg = <0x50>;
				pagesize = <8>;
				//read-only;
			};
		};	
	};
};
