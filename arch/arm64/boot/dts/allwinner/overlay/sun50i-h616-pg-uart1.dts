/dts-v1/;
/plugin/;

/ {
	fragment@0 {
		target-path = "/aliases";
		__overlay__ {
			serial1 = "/soc/serial@5000400";
		};
	};

	fragment@1 {
		target = <&uart1>;
		__overlay__ {
			pinctrl-names = "default";
			pinctrl-0 = <&uart1_ph_pins>;
			status = "okay";
		};
	};
};
