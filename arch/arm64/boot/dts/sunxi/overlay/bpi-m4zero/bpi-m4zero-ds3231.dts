/dts-v1/;
/plugin/;

/ {
	fragment@0 {
		target = <&twi0>;

		__overlay__ {
			status = "okay";

			/* rtc-ds1307.ko */
			ds3231: rtc@68 {
				status = "okay";
				compatible = "ds3231";
				reg = <0x68>;
			};
		};
	};

	fragment@1 {
		target = <&rtc>;

		__overlay__ {
			status = "disabled";
		};
	};
};
