/dts-v1/;
/plugin/;

/ {
	fragment@2 {
		target = <&ahub2_plat>;
		__overlay__ {
                        status = "okay";
		};
	};

	fragment@3 {
		target = <&ahub2_mach>;
		__overlay__ {
			status = "okay";

			soundcard-mach,capture-only;
		};
	};
};
