/dts-v1/;
/plugin/;

/ {
	fragment@0 {
		target = <&twi4>;

		__overlay__ {
			status = "okay";

			at24@50 {
				compatible = "at24,24c02";
				reg = <0x50>;
				pagesize = <8>;
				//read-only;
			};
		};
	};
};
