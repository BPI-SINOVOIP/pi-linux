## Documentation/devicetree/bindings/iio/magnetometer/voltafield,af8133j.yaml
```yaml
# SPDX-License-Identifier: (GPL-2.0 OR BSD-2-Clause)
%YAML 1.2
---
$id: http://devicetree.org/schemas/iio/magnetometer/asahi-kasei,ak8975.yaml#
$schema: http://devicetree.org/meta-schemas/core.yaml#

title: Voltafield AF8133J magnetometer sensor

maintainers:
  - Icenowy Zheng <icenowy@aosc.io>

properties:
  compatible:
    - voltafield,af8133j

  reg:
    maxItems: 1

  reset-gpios:
    description: |
      an pin needed for AF8133J to set the reset state. This should be usually
      active low.

  avdd-supply:
    description: |
      an optional regulator that needs to be on to provide AVDD power (Working
      power, usually 3.3V) to the sensor.

  avdd-supply:
    description: |
      an optional regulator that needs to be on to provide DVDD power (Digital
      IO power, 1.8V~AVDD) to the sensor.

  mount-matrix:
    description: an optional 3x3 mounting rotation matrix.

required:
  - compatible
  - reg
  - reset-gpios

additionalProperties: false

examples:
  - |
    #include <dt-bindings/interrupt-controller/irq.h>
    #include <dt-bindings/gpio/gpio.h>
    i2c {
        #address-cells = <1>;
        #size-cells = <0>;

        magnetometer@1c {
            compatible = "voltafield,af8133j";
            reg = <0x1c>;
            avdd-supply = <&reg_dldo1>;
            dvdd-supply = <&reg_dldo1>;
            reset-gpios = <&pio 1 1 GPIO_ACTIVE_LOW>;
        };
    };
```

## Documentation/devicetree/bindings/sound/cnxt,cx9000.txt
```
Conexant/Synaptics CX9000 Smart Amplifier

The devices supports the I2C bus.

Required properties:

  - compatible: One of "cnxt,cx9000".
  - reg: The I2C address of the device for I2C, it should be <0x33>

CODEC output pins:
  "Speaker"	- Speaker output

Example:

codec_i2c: cx9000@33 {
	compatible = "cnxt,cx9000";
	reg = <0x33>;
};
```

## Documentation/devicetree/bindings/sound/syna,berlin-aout.txt
```
Synaptics Berlin Sound Output

This devices handle all sound stream related operations

Required properties:

  - compatible : should be one of:
	"syna,berlin-aout"

Optional properties:

Example:
aout {
	compatible = "syna,berlin-aout";
	interrupt-parent = <&dhubctr_a>;
	interrupts = <0>, <2>, <7>, <14>;
	interrupt-names = "ma0", "loro", "hdmi", "spdif";
};
```

## Documentation/devicetree/bindings/sound/syna,berlin-hrx.txt
```
Synaptics Berlin HdmiRx Input

This devices handle all hdmirx related operations

Required properties:

  - compatible : should be one of:
	"syna,berlin-hrx"

Optional properties:

Example:
hrx {
	compatible = "syna,berlin-hrx";
	interrupt-parent = <&dhubctr_a>;
	interrupts = <9>, <23>, <24>, <25>, <26>, <27>;
	interrupt-names = "mic3", "otg", "hdmirx", "ytg", "uvtg", "itg";
};
```

## Documentation/devicetree/bindings/sound/syna,hdmi-out.txt
```
Synaptics Berlin Sound Output

This devices handle all sound stream related operations

Required properties:

  - compatible : should be one of:
	{ .compatible = "syna,vs640-hdmi",  },
	{ .compatible = "syna,vs680-hdmi",  },

Optional properties:

Example:
		hdmi_out: hdmi-out{
			compatible = "syna,vs680-hdmi";
			status = "disabled";
			interrupt-parent = <&dhubctr_a>;
			interrupts = <7>;
			interrupt-names = "hdmi";
		};

		hdmi_out: hdmi-out{
			compatible = "syna,vs640-hdmi";
			status = "disabled";
			interrupt-parent = <&dhubctr_a>;
			interrupts = <7>;
			interrupt-names = "hdmi";
		};
```

## Documentation/devicetree/bindings/sound/syna,i2s-pri.txt
```
Synaptics Berlin Sound Output

This devices handle all sound stream related operations

Required properties:

  - compatible : should be one of:
	 .compatible = "syna,as370-outdai",
	 .compatible = "syna,vs680-i2s-pri",
	 .compatible = "syna,as470-outdai",
	 .compatible = "syna,vs640-i2s-pri",

Optional properties:

Example:
	i2s_pri: i2s-pri {
		compatible = "syna,vs680-i2s-pri";
		status = "disabled";
		interrupt-parent = <&dhubctr_a>;
		interrupts = <0>;
		interrupt-names = "pri";
	};

	i2s_pri: i2s-pri {
		compatible = "syna,vs640-i2s-pri";
		status = "disabled";
		interrupt-parent = <&dhubctr_a>;
		interrupts = <0>;
		interrupt-names = "pri";
	};
```

## Documentation/devicetree/bindings/sound/syna,i2s-sec.txt
```
Synaptics Berlin Sound Output

This devices handle all sound stream related operations

Required properties:

  - compatible : should be one of:
	{ .compatible = "syna,as370-sec",  },
	{ .compatible = "syna,as470-sec",  },
	{ .compatible = "syna,vs680-i2s-sec",  },
	{ .compatible = "syna,vs640-i2s-sec",  },

Optional properties:

Example:
	i2s_sec: i2s-sec {
		compatible = "syna,vs680-i2s-sec";
		status = "disabled";
		interrupt-parent = <&dhubctr_a>;
		interrupts = <2>;
	};

	i2s_sec: i2s-sec {
		compatible = "syna,vs640-i2s-sec";
		status = "disabled";
		interrupt-parent = <&dhubctr_a>;
		interrupts = <2>;
	};
```

## Documentation/devicetree/bindings/sound/syna,spdif-out.txt
```
Synaptics Berlin Sound Output

This devices handle all sound stream related operations

Required properties:

  - compatible : should be one of:
	{ .compatible = "syna,vs680-spdifo",  },
	{ .compatible = "syna,vs640-spdifo",  },

Optional properties:

Example:
	spdif_out: spdif-out {
		compatible = "syna,vs680-spdifo";
		status = "disabled";
		interrupt-parent = <&dhubctr_a>;
		interrupts = <14>;
		interrupt-names = "spdifo";
	};

	spdif_out: spdif-out {
		compatible = "syna,vs640-spdifo";
		status = "disabled";
		interrupt-parent = <&dhubctr_a>;
		interrupts = <14>;
		interrupt-names = "spdifo";
	};
```

## Documentation/devicetree/bindings/sound/syna,vs680-dmic.txt
```
Synaptics VS680 Digital Microphone capture DAI configuration

Required properties:
  - compatible : "syna,syna,vs680-dmic-pdm"
  - interrupts : adhub irq number (dhub channel number)
  - interrupt-parent : dhub irq controller, see "syna,berlin-dhub-irq.txt"

Optional properties:
  - pdm-type : three types
	       0: 2ch SPDIFI pad
	       1: 8ch I2S2_DI3, I2S2_DI2, I2S2_DI1, I2S2_DI0
	       2: 8ch I2S2_DI3, I2S2_DI2, I2S1_DO3, I2S1_DO2
  - pdm-clk-sel:
             000: Clock A (I2S2_BCLKIO) Master Mode and PDMA_CLKIO_DO_FB
		  (Core → loopback before I2S2_BCLKIO pad → mux input)
	     001: Clock A Slave Mode and PDMA_CLKIO_DI_2mux
		  (From I2S2_BCLKIO pad)
	     010: Clock B (I2S2_MCLK) Master Mode and PDMB_CLKIO_DO_FB
		  (Core → loopback before I2S2_MCLK pad → input of mux)
	     011: Clock B Slave Mode and PDMB_CLKIO_DI_2mux
		  (From I2S2_MCLK pad)
	     1xx: I2S2 BCLK Cross feed and I2S2_BCLKIO_DI_2module
		  (After I2S2BCLK Final clock mux.)
  - channels-map: array indicates which channel connected to dmic.
		  set 1: dmic available. set 0: no dmic.

Example:
dmic: dmic-pdm {
	compatible = "syna,vs680-dmic-pdm";
	status = "disabled";
	interrupt-parent = <&dhubctr_a>;
	interrupts = <4>;
	pdm-type = <1>;
	pdm-clk-sel = <2>;
	channels-map = <1 1 1 1 0 0 0 0>;
};
```

## drivers/clk/berlin/Kconfig
```kconfig
# SPDX-License-Identifier: GPL-2.0-only

config SYNA_VS680_PLL
	tristate "Synaptics VS680 pll drivers"
	depends on ARCH_BERLIN
	help
	  Build the pll drivers for berlin VS680/VS640 SOCs.

config SYNA_AS370_PLL
	tristate "Synaptics AS370 pll drivers"
	depends on ARCH_BERLIN
	help
	  Build the pll drivers for berlin AS370/AS470 SOCs.

config SYNA_CLK_BASE
	tristate "Synaptics switch/gate base drivers"
	depends on ARCH_BERLIN
	help
	  Build the base clk driver for synaptics SOCs.

config SYNA_AS370_CLK
	tristate "Synaptics AS370 SOC's switch/gate clk drivers"
	depends on SYNA_CLK_BASE
	help
	  Build the clk drivers for berlin AS370 SOCs.

config SYNA_AS470_CLK
	tristate "Synaptics AS470 SOC's switch/gate clk drivers"
	depends on SYNA_CLK_BASE
	help
	  Build the clk drivers for berlin AS470 SOCs.

config SYNA_VS640_CLK
	tristate "Synaptics VS640 SOC's switch/gate clk drivers"
	depends on SYNA_CLK_BASE
	help
	  Build the clk drivers for berlin VS640 SOCs.

config SYNA_VS680_CLK
	tristate "Synaptics VS680 SOC's switch/gate clk drivers"
	depends on SYNA_CLK_BASE
	help
	  Build the clk drivers for berlin VS680 SOCs.
```

## drivers/input/touchscreen/gt9xx/Kconfig
```kconfig
config TOUCHSCREEN_GT9XX
    tristate "Gt9xx touchscreen"
    depends on INPUT_TOUCHSCREEN
    help
        Say Y here if you have a Gt9xx IC and want to enable
        support for the built-in touchscreen.
        If unsure, say N.
```

## drivers/media/platform/sunxi/sun50i-di/Kconfig
```kconfig
# SPDX-License-Identifier: GPL-2.0-only
config VIDEO_SUN50I_DEINTERLACE
	tristate "Allwinner Deinterlace v2 driver"
	depends on V4L_MEM2MEM_DRIVERS
	depends on VIDEO_DEV
	depends on ARCH_SUNXI || COMPILE_TEST
	depends on COMMON_CLK && OF
	depends on PM
	select VIDEOBUF2_DMA_CONTIG
	select V4L2_MEM2MEM_DEV
	help
	   Support for the Allwinner deinterlace v2 unit found on
	   some SoCs, like H6.
	   To compile this driver as a module choose m here.
```

## drivers/misc/openvfd/Kconfig
```kconfig
# SPDX-License-Identifier: GPL-2.0

config LED_OPENVFD
	tristate "OpenVFD 7-segment LED display driver"
	default m
	help
	  Support for 7-segment LED displays based on FD628
	  FD650, HD44780, IL3829, PCD8544 and SSD1306
```

## drivers/phy/synaptics/Kconfig
```kconfig
#
# Phy drivers for Synaptics platforms
#

config PHY_BERLIN_PCIE
	tristate "Synaptics Berlin PCIE PHY Driver"
	depends on ARCH_BERLIN && RESET_CONTROLLER && HAS_IOMEM && OF
	select GENERIC_PHY
	help
	  Enable this to support the PCIE PHY on Synaptics SoCs.

config PHY_BERLIN_SATA
	tristate "Synaptics Berlin SATA PHY driver"
	depends on ARCH_BERLIN && HAS_IOMEM && OF
	select GENERIC_PHY
	help
	  Enable this to support the SATA PHY on Synaptics Berlin SoCs.

config PHY_BERLIN_USB
	tristate "Synaptics Berlin USB PHY Driver"
	depends on ARCH_BERLIN && RESET_CONTROLLER && HAS_IOMEM && OF
	select GENERIC_PHY
	help
	  Enable this to support the USB PHY on Synaptics Berlin SoCs.

config PHY_SYNA_USB
	tristate "Synaptics USB PHY Driver"
	depends on ARCH_BERLIN && RESET_CONTROLLER && HAS_IOMEM && OF
	select GENERIC_PHY
	help
	  Enable this to support the USB PHY on Synaptics SoCs.
```

## drivers/pinctrl/berlin/Kconfig
```kconfig
# SPDX-License-Identifier: GPL-2.0-only
if (ARCH_BERLIN || COMPILE_TEST)

config PINCTRL_BERLIN
	bool
	select PINMUX
	select GENERIC_PINCONF
	select REGMAP_MMIO

config PINCTRL_AS370
	bool "Synaptics as370 pin controller driver"
	depends on OF
	select PINCTRL_BERLIN

config PINCTRL_AS470
	bool "Synaptics as470 pin controller driver"
	depends on OF
	select PINCTRL_BERLIN

config PINCTRL_BERLIN_BG2
	def_bool MACH_BERLIN_BG2
	depends on OF
	select PINCTRL_BERLIN

config PINCTRL_BERLIN_BG2CD
	def_bool MACH_BERLIN_BG2CD
	depends on OF
	select PINCTRL_BERLIN

config PINCTRL_BERLIN_BG2Q
	def_bool MACH_BERLIN_BG2Q
	depends on OF
	select PINCTRL_BERLIN

config PINCTRL_BERLIN_BG4CT
	bool "Marvell berlin4ct pin controller driver"
	depends on OF
	select PINCTRL_BERLIN

config PINCTRL_VS640
	bool "Synaptics VS640 pin controller driver"
	depends on OF
	select PINCTRL_BERLIN

config PINCTRL_VS680
	bool "Synaptics VS680 pin controller driver"
	depends on OF
	select PINCTRL_BERLIN

endif
```

## drivers/soc/berlin/Kconfig
```kconfig
# SPDX-License-Identifier: GPL-2.0-only
#
# Berlin SoC drivers
#
menu "Berlin SoC drivers"
	depends on ARCH_BERLIN || COMPILE_TEST

source "drivers/soc/berlin/Kconfig.avio"
source "drivers/soc/berlin/Kconfig.isp"
source "drivers/soc/berlin/Kconfig.gpu"

config BERLIN_CHIPID
	bool "Support BERLIN CHIPID"
	default n
	select SOC_BUS
	help
	  If you say Y here you get support for the BERLIN CHIP id

config BERLIN_SM
	bool "Support SM CPU"
	default n
	select POWER_RESET
	select REBOOT_MODE
	help
	  Enable support for SM(System Manager) which is designed for front
	  panel control and power management.

config BERLIN_TZD
	tristate "Support Synaptics ARM TrustZone"
	default n
	help
	  Enable support for Synaptics ARM TrustZone

config BERLIN_SHM
	tristate "Support BERLIN SHM"
	default n
	depends on ION
	help
	  SHM support

config BERLIN_VPP
	tristate "Support Berlin VPP module"
	default n
	depends on ION && BERLIN_AVIO
	help
	  This is the VPP module for Berlin.

config BERLIN_CC
	tristate "Support BERLIN CC"
	default n
	help
	  Enable support for BERLIN CC

config BERLIN_AVIO
	tristate "Support AVIO"
	default n
	select BERLIN_MSGQ
	select BERLIN_TZD
	help
	  Enable support for AVIO

config BERLIN_MSGQ
	tristate "Support Message Q"
	default n
	help
	  Enable support for MSGQ

config BERLIN_VPU
	tristate "Support BERLIN VPU"
	default n
	select BERLIN_MSGQ
	help
	  Enable support for VPU

config SYNA_ISP
	tristate "Support for ISP"
	default n
	help
	  isp core driver

config BERLIN_TSP
	tristate "Support BERLIN TSP"
	default n
	select BERLIN_MSGQ
	help
	  Enable support for TSP

config BERLIN_AXI_METER
	tristate "Support AXI performance meter"
	default n
	help
	  axi performance meter support

config BERLIN_AOUT
	tristate "Support BERLIN AOUT"
	default n
	select BERLIN_DHUB_IRQ
	depends on BERLIN_MSGQ && BERLIN_SHM && BERLIN_AVIO
	help
	  AOUT support

config POWERVR_ROGUE
	tristate "PowerVR rogue android driver"
	default n
	help
	  Imagination gpu driver for android

config POWERVR_ROGUE_WS
	tristate "PowerVR rogue Linux window system driver"
	default n
	help
	  Imagination gpu driver for Linux window system

config BERLIN_NSK
	tristate "Support BERLIN NSK"
	default n
	help
	  NSK support

config BERLIN_OVP
	tristate "Support OVP"
	default n
	select BERLIN_MSGQ
	select BERLIN_TZD
	help
	  Enable support for OVP

config BERLIN_SCRD
	tristate "Support BERLIN SMARTCARD"
	default n
	select BERLIN_MSGQ
	help
	  Enable support for Smart card

config BERLIN_CEC
	tristate "Support BERLIN CEC"
	default n
	select BERLIN_MSGQ
	help
	  Enable support for CEC

config HIFI_DSP
	tristate "Support HIFI DSP"
	default n
	depends on BERLIN_MSGQ
	help
	  DSP support

config BERLIN_VSYNC
	tristate "Support BERLIN VSYNC"
	default n
	help
	  Enable Berlin Vsync

config BERLIN_HRX
	tristate "Support BERLIN HRX"
	default n
	select BERLIN_DHUB_IRQ
	depends on BERLIN_MSGQ && BERLIN_SHM && BERLIN_AVIO
	help
	  HRX support

config BERLIN_IFCP
	tristate "Support Irdeto IFCP"
	default n
	help
	  Enable support for Irdeto IFCP

config BERLIN_BM
	tristate "Support BERLIN BM"
	default n
	depends on ION_HEAP_EXTRA
	help
	 AMP buffer meta data management module

config SYNAPTICS_BT_DEVICE
	bool "BT Device support"
	depends on BT && RFKILL
	default n
	help
	  Say Y here if you want to use the BT device.

config SYNA_DRM
	tristate "synaptics drm display module"
	default n
	select BERLIN_VPP
	select BERLIN_AVIO
	help
	  synaptics drm display support

config SYNA_MC_DFC
	tristate "Support MC hwcc"
	default n
	help
	  MC DFC HWCC for DDR frequency switch on the fly.

endmenu
```

## drivers/soc/berlin/Kconfig.avio
```kconfig
#
# AVIO variants
#

if ARCH_BERLIN

choice
	prompt	"Synaptics AVIO Variants"
	default	AVIO_NONE

config AVIO_NONE
	bool	"Not select any AVIO variant in default"

config AVIO_AS370
	bool	"Synaptics AS370"

config AVIO_AS470
	bool	"Synaptics AS470"

config AVIO_VS640
	bool	"Synaptics VS640"

config AVIO_VS680
	bool	"Synaptics VS680"

config AVIO_VS680_A0
	bool	"Synaptics VS680 A0"

endchoice

endif
```

## drivers/soc/berlin/Kconfig.gpu
```kconfig
#
# GPU variants
#

choice
	prompt	"Synaptics GPU Variants"
	default	GPU_VS640

config GPU_VS640
	bool	"Synaptics VS640"

config GPU_VS680
	bool	"Synaptics VS680"

endchoice
```

## drivers/soc/berlin/Kconfig.isp
```kconfig
#
# ISP variants
#

if SYNA_ISP

choice
	prompt	"Synaptics ISP Variants"
	default	ISP_NONE

config ISP_NONE
	bool	"Not select any ISP variant in default"

config ISP_VS680
	bool	"Synaptics VS680"

config ISP_VS680_A0
	bool	"Synaptics VS680 A0"

endchoice

endif
```
