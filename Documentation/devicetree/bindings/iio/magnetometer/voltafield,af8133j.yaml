## drivers/staging/android/ion/heaps/Kconfig
```kconfig
# SPDX-License-Identifier: GPL-2.0
config ION_SYSTEM_HEAP
	tristate "Ion system heap"
	depends on ION
	help
	  Choose this option to enable the Ion system heap. The system heap
	  is backed by pages from the buddy allocator. If in doubt, say Y.

config ION_CMA_HEAP
	tristate "Ion CMA heap support"
	depends on ION && DMA_CMA
	help
	  Choose this option to enable CMA heaps with Ion. This heap is backed
	  by the Contiguous Memory Allocator (CMA). If your system has these
	  regions, you should say Y here.

config ION_HEAP_EXTRA
	tristate "Ion heap extra function support"
	depends on ION
	help
	  Choose this option to enable ION heap extra functions, currently it
	  only supports heap call back register.

config ION_BERLIN_HEAP
	tristate "Ion BERLIN heap support"
	depends on ION_HEAP_EXTRA
	help
	  Choose this option to enable BERLIN heaps with Ion. This heap is to
	  support berlin platform related features.

config ION_SYSTEM_CUST_HEAP
	tristate "Ion system cust heap"
	depends on ION_HEAP_EXTRA
	help
	  Choose this option to enable the customized Ion system heap. If in
	  doubt, say N.

config ION_CMA_CUST_HEAP
	tristate "Ion CMA cust heap support"
	depends on ION_HEAP_EXTRA && DMA_CMA
	help
	  Choose this option to enable CMA customized heaps with Ion. If in
	  doubt, say N.
```

## drivers/synap/kernel/Kconfig
```kconfig
config SYNAP
	tristate "synap"
	---help---
	SYNAP NPU kernel driver
	  To compile this driver as a module, choose M here: the
	  module will be called synap.
```

## drivers/video/syna/Kconfig
```kconfig
menuconfig SYNA_FBDEV
	depends on FB && BERLIN_VPP
	default n
	tristate "Helper for implementing the fbdev API in SYNA drivers"
```

## sound/soc/syna/Kconfig
```kconfig
menuconfig SND_SOC_SYNA
	tristate "ASoC support for Synaptics"
	help
	  Say Y or M if you want to add support for Synaptics SoCs'
	  Audio interfaces. You will also need to select the audio
	  interfaces below to support them.

if SND_SOC_SYNA

config SND_SOC_BERLIN_ASOC
	tristate "ASoC for the BERLIN chip"
	depends on OF && I2C
	help
	  Say Y if you want to add Synaptics Berlin machine driver.

config SND_SOC_BERLIN_PCM
	tristate "Berlin PCM platform driver"
	select SND_HWDEP
	select BERLIN_AVIO
	select BERLIN_DHUB_IRQ
	depends on INPUT
	help
	  Say Y if you want to add Synaptics Berlin PCM driver.

config SND_SOC_BERLIN_PRI
	tristate "Berlin primary outdai driver"
	select BERLIN_AVIO
	select SND_SOC_BERLIN_PCM
	help
	  Say Y if you want to enable Synaptics Berlin Pri playback driver.

config SND_SOC_BERLIN_SEC
	tristate "Berlin secondary outdai driver"
	select BERLIN_AVIO
	select SND_SOC_BERLIN_PCM
	help
	  Say Y if you want to enable Synaptics Berlin Sec playback driver.

config SND_SOC_BERLIN_SPDIFO
	tristate "Berlin spdif out dai driver"
	select BERLIN_AVIO
	select SND_SOC_BERLIN_PCM
	help
	  Say Y if you want to enable Synaptics Berlin spdif playback driver.

config SND_SOC_BERLIN_HDMI
	tristate "Berlin hdmi dai driver"
	select BERLIN_AVIO
	select SND_SOC_BERLIN_PCM
	help
	  Say Y if you want to enable Synaptics Berlin Hdmi playback driver.

config SND_SOC_BERLIN_PDMI
	tristate "Berlin PDM input dai driver"
	select BERLIN_AVIO
	select SND_SOC_BERLIN_PCM
	help
	  Say Y if you want to enable Synaptics Berlin PDM capture driver.

config SND_SOC_BERLIN_MIC1
	tristate "Berlin MIC1 dai driver"
	select BERLIN_AVIO
	select SND_SOC_BERLIN_PCM
	help
	  Say Y if you want to enable Synaptics Berlin MIC1 driver.

config SND_SOC_BERLIN_MIC2
	tristate "Berlin MIC2 dai driver"
	select BERLIN_AVIO
	select SND_SOC_BERLIN_PCM
	help
	  Say Y if you want to enable Synaptics Berlin MIC2 driver.

config SND_SOC_BERLIN_MIC6
	tristate "Berlin MIC6 dai driver"
	select BERLIN_AVIO
	select SND_SOC_BERLIN_PCM
	help
	  Say Y if you want to enable Synaptics Berlin MIC6 driver.

config SND_SOC_BERLIN_PRI_LOOPBACK
	tristate "Berlin Pri Loopback dai driver"
	select BERLIN_AVIO
	select SND_SOC_BERLIN_PCM
	help
	  Say Y if you want to enable Synaptics Berlin Pri Loopback driver.

config SND_SOC_BERLIN_HDMI_LOOPBACK
	tristate "Berlin HDMI Loopback dai driver"
	select BERLIN_AVIO
	select SND_SOC_BERLIN_PCM
	help
	  Say Y if you want to enable Synaptics Berlin HDMI Loopback driver.

config SND_SOC_BERLIN_SPDIFI
	tristate "Berlin SPDIF RX dai driver"
	select BERLIN_AVIO
	select SND_SOC_BERLIN_PCM
	help
	  Say Y if you want to enable Synaptics Berlin SPDIF RX driver.

config SND_SOC_BERLIN_DMIC
	tristate "Berlin DMIC dai driver"
	select BERLIN_AVIO
	select SND_SOC_BERLIN_PCM
	help
	  Say Y if you want to enable Synaptics Berlin DMIC driver.
endif #SND_SOC_SYNA
```
