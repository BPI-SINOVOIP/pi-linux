## drivers/drp/Kconfig
```kconfig
#
# DRP subsystem configuration
#

menu "DRP/DRP support"

config DRP
    bool "DRP support"
    default y
    help
      DRP is a peripheral hardware that accelerates image processing.
      If you want DRP support, you should say Y here.

config DRP_SUPPORT_MULTI_OS
    bool "Support Multiple OS System"
    depends on !ARCH_R9A09G056
    default n
    help
        If you want to use multiple OS system (assumed with RTOS), you should say Y here.

config DRP_INIT_SHARED_MEMORY
    bool "Initialize Shared Memory"
    depends on !ARCH_R9A09G056
    default n
    help
        If you want to initialize shard memory, you should say Y here.
        When "Support Multiple OS System" is 'Y', this option is enable.  

endmenu
```

## drivers/media/platform/renesas/rzv2n-ivc/Kconfig
```kconfig
# SPDX-License-Identifier: GPL-2.0
config VIDEO_RZV2N_IVC
	tristate "RZ/V2N Input Video Control Driver"
	depends on VIDEO_V4L2_SUBDEV_API && OF && MEDIA_CONTROLLER
	depends on ARCH_RENESAS || COMPILE_TEST
	select VIDEOBUF2_DMA_CONTIG
	select V4L2_FWNODE
	select VIDEOBUF_GEN
	select VIDEOBUF2_CORE
	select VIDEOBUF2_MEMOPS
	select VIDEOBUF2_VMALLOC
	select VIDEOBUF2_DMA_CONTIG
	select VIDEOBUF2_DMA_SG
	select V4L2_MEM2MEM_DEV
	select VIDEO_MEM2MEM_DEINTERLACE
	select VIDEO_RZG2L_CRU
	select VIDEO_RZG2L_CSI2
	help
	  Support for Renesas RZ/V2N Image Signal Processor (ISP) Driver

	  To compile this driver as a module, choose M here: the
	  module will be called rzv2n-isp.
```

## drivers/renesas/Kconfig
```kconfig
# SPDX-License-Identifier: GPL-2.0-only

menuconfig RENESAS_EXTRA_DRIVER
	bool "Renesas Extra drivers"
	default n
	help
	  this option is provided for control Renesas extra drivers.

if RENESAS_EXTRA_DRIVER

source "drivers/renesas/mmngrbuf/Kconfig"
source "drivers/renesas/mmngr/Kconfig"
source "drivers/renesas/uvcs_drv/Kconfig"
source "drivers/renesas/vspmif/Kconfig"
source "drivers/renesas/vspm/Kconfig"

endif
```

## drivers/renesas/mmngr/Kconfig
```kconfig
# SPDX-License-Identifier: GPL-2.0-only

config RENESAS_MMNGR
	tristate "Renesas mmngr driver"
	depends on ARCH_RENESAS
	help
	  Say Y here if you want enable Renesas mmngr driver
```

## drivers/renesas/mmngrbuf/Kconfig
```kconfig
# SPDX-License-Identifier: GPL-2.0-only

config RENESAS_MMNGRBUF
	tristate "Renesas mmngrbuf driver"
	depends on ARCH_RENESAS
	help
	  Say Y here if you want enable Renesas mmngrbuf driver
```

## drivers/renesas/uvcs_drv/Kconfig
```kconfig
# SPDX-License-Identifier: GPL-2.0-only

config RENESAS_UVCS_DRV
	tristate "Renesas uvcs_drv driver"
	depends on ARCH_RENESAS
	help
	  Say Y here if you want enable Renesas uvcs_drv driver
```

## drivers/renesas/vspmif/Kconfig
```kconfig
# SPDX-License-Identifier: GPL-2.0-only

config RENESAS_VSPM_IF
	tristate "Renesas vspm_if driver"
	depends on ARCH_RENESAS
	help
	  Say Y here if you want enable Renesas vspm_if driver
```
